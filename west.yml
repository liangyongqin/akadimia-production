## west.yml
```yaml
manifest:
  self:
    path: akadimia-production
  
  remotes:
    - name: akadimia-sdk
      url-base: https://github.com/liangyongqin

  projects:
    - name: akadimia-sdk
      remote: akadimia-sdk
      path: akadimia-sdk
```
